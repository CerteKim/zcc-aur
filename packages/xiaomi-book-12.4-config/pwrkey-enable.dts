// SPDX-License-Identifier: BSD-3-Clause
/*
 * Xiaomi Book S 12.4 (SC8180X) — enable the PM8150 PMIC power key.
 *
 * sc8180x-pmics.dtsi declares the PM8150 PON power key (KPDPWR_N) but leaves
 * it `status = "disabled"`, and the Xiaomi board DTS never enables it:
 *
 *     pon@800 {
 *             compatible = "qcom,pm8916-pon";
 *             pmc8180_pwrkey: pwrkey {
 *                     compatible = "qcom,pm8941-pwrkey";
 *                     interrupts = <0 0x8 0 IRQ_TYPE_EDGE_BOTH>;
 *                     linux,code = <KEY_POWER>;
 *                     status = "disabled";
 *             };
 *     };
 *
 * With the node disabled, pm8941-pwrkey never probes, so no input device
 * reports EV_KEY/KEY_POWER and systemd-logind never sees the press.  Upstream
 * fixed the same omission for the other SC8180X devices in 3706bcfbdb8a
 * ("arm64: dts: qcom: sc8180x: Enable the power key").
 *
 * This overlay is the runtime equivalent of that one-line fix and is applied
 * with fdtoverlay, so the pristine DTB stays available as a fallback GRUB
 * entry.
 */

/dts-v1/;
/plugin/;

&pmc8180_pwrkey {
	status = "okay";
};
